## BL654/Chrono_amp_interrupt_BL654/build_1/Kconfig/Kconfig.shield
```kconfig
osource "c:/users/mahdi/documents/github/bl654-nrf52840/chrono_amp_interrupt_bl654/boards/shields/*/Kconfig.shield"
osource "C:/ncs/v2.1.2/nrf/boards/shields/*/Kconfig.shield"
```

## BL654/amperometric_interrupt_BL654/build_1/Kconfig/Kconfig.shield
```kconfig
osource "c:/users/mahdi/documents/github/bl654-nrf52840/amperometric_interrupt_bl654/boards/shields/*/Kconfig.shield"
osource "C:/ncs/v2.1.2/nrf/boards/shields/*/Kconfig.shield"
```

## BL654/amperometric_polling_BL654/build_1/Kconfig/Kconfig.shield.defconfig
```kconfig
osource "c:/users/mahdi/documents/github/bl654-nrf52840/amperometric_polling_bl654/boards/shields/*/Kconfig.defconfig"
osource "C:/ncs/v2.1.2/nrf/boards/shields/*/Kconfig.defconfig"
```
